## board/devsoc/Kconfig
```kconfig
if ARCH_DEVSOC

config SYS_CPU
       default "devsoc"

config SYS_BOARD
       default "devsoc"

config SYS_VENDOR
       default "qca/arm"

config SYS_CONFIG_NAME
       default "devsoc"

config NAND_FLASH
	bool "Enable NAND Framework"

config QPIC_SERIAL
	bool "Enable QPIC serial NAND"

config UBI_WRITE
	bool "Enable ubi utilities"

config MMC_FLASH
	bool "Enable MMC flash support"

config PCI_IPQ
	bool "Enable pci support"

config USB_XHCI_IPQ
	bool "Enable usb support"

config IPQ_I2C
	bool "Enable i2c support"

config IPQ_TINY
	bool "Enable Tiny support"

config IPQ_TINY_SPI_NOR
	bool "This config helps to update spi-nor"

config ART_COMPRESSED
	bool "Enable uncompress support"

config QCA8033_PHY
	bool "Enable QCA8033 PHY support"

config QCA8081_PHY
	bool "Enable QCA8081 PHY support"
endif
```

## net/Kconfig
```kconfig
#
# Network configuration
#

menuconfig NET
	bool "Networking support"

if NET

config NET_RANDOM_ETHADDR
	bool "Random ethaddr if unset"
	select LIB_RAND
	help
	  Selecting this will allow the Ethernet interface to function
	  even when the ethaddr variable for that interface is unset.
	  A new MAC address will be generated on every boot and it will
	  not be added to the environment.

config NETCONSOLE
	bool "NetConsole support"
	help
	  Support the 'nc' input/output device for networked console.
	  See README.NetConsole for details.

config NET_TFTP_VARS
	bool "Control TFTP timeout and count through environment"
	default y
	help
	  If set, allows controlling the TFTP timeout through the
	  environment variable tftptimeout, and the TFTP maximum
	  timeout count through the variable tftptimeoutcountmax.
	  If unset, timeout and maximum are hard-defined as 1 second
	  and 10 timouts per TFTP transfer.

config PROT_UDP
	bool "Enable generic udp framework"
	help
	  Enable a generic udp framework that allows defining a custom
	  handler for udp protocol.

config PROT_TCP
	bool "TCP stack"
	help
	  Enable a generic tcp framework that allows defining a custom
	  handler for tcp protocol.

config PROT_TCP_SACK
	bool "TCP SACK support"
	depends on PROT_TCP
	help
	  TCP protocol with SACK. SACK means selective acknowledgements.
	  By turning this option on TCP will learn what segments are already
	  received. So that it improves TCP's retransmission efficiency.
	  This option should be turn on if you want to achieve the fastest
	  file transfer possible.

endif   # if NET
```
